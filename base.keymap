
#include <behaviors.dtsi>
#include <dt-bindings/zmk/keys.h>
#include <dt-bindings/zmk/outputs.h>
#include <dt-bindings/zmk/pointing.h>
#include <dt-bindings/zmk/bt.h>

#include "zmk-helpers/helper.h"


#define DEF 0
#define NAV 1
#define FN 2
#define NUM 3
#define SYS 4
#define MOUSE 5


// #define KEYS_L LT0 LT1 LT2 LT3 LT4 LT5 LM0 LM1 LM2 LM3 LM4 LM5 LB0 LB1 LB2 LB3 LB4 LB5  // left hand
// #define KEYS_R RT0 RT1 RT2 RT3 RT4 RT5 RM0 RM1 RM2 RM3 RM4 RM5 RB0 RB1 RB2 RB3 RB4 RB5  // right hand
// #define THUMBS LH2 LH1 LH0 RH0 RH1 RH2    


ZMK_HOLD_TAP(hml,
    flavor = "balanced";
    tapping-term-ms = <280>;
    require-prior-idle-ms = <150>;
    hold-trigger-key-positions = <KEYS_R THUMBS>;
    hold-trigger-on-release;
    bindings = <&kp>, <&kp>;
)

ZMK_HOLD_TAP(hmr,
    flavor = "balanced";
    tapping-term-ms = <280>;
    require-prior-idle-ms = <150>;
    hold-trigger-key-positions = <KEYS_L THUMBS>;
    hold-trigger-on-release;
    bindings = <&kp>, <&kp>;
)

#define COMBO_TERM_FAST 18
#define COMBO_TERM_SLOW 30

#define COMBO_IDLE_FAST 150
#define COMBO_IDLE_SLOW 50

ZMK_COMBO(cut,   &kp LC(X),    LB3 LB1)
ZMK_COMBO(copy,  &kp LC(C),  LB3 LB2)
ZMK_COMBO(paste, &kp LC(V),  LB2 LB1)

ZMK_COMBO(esc , &kp ESC , LT5 LT4)
ZMK_COMBO(lpar, &kp LPAR , RT1 RT2)
ZMK_COMBO(rpar, &kp RPAR , RT2 RT3)
ZMK_COMBO(lbkt, &kp LBKT , RM1 RM2)
ZMK_COMBO(rbkt, &kp RBKT , RM2 RM3)
ZMK_COMBO(lbrc, &kp LBRC , RB1 RB2)
ZMK_COMBO(rbrc, &kp RBRC , RB2 RB3)
ZMK_COMBO(bslh, &kp BSLH , RB3 RB4)
ZMK_COMBO(lt, &kp LT , RT0 RT1)
ZMK_COMBO(gt, &kp GT , RM0 RM1)
