/*
 * Copyright (c) 2020 The ZMK Contributors
 *
 * SPDX-License-Identifier: MIT
 */

#include "zmk-helpers/key-labels/42.h"

#include <behaviors.dtsi>
/*                                      42 KEY MATRIX / LAYOUT MAPPING

  ╭────────────────────────┬────────────────────────╮ ╭─────────────────────────┬─────────────────────────╮
  │  0   1   2   3   4   5 │  6   7   8   9  10  11 │ │ LT5 LT4 LT3 LT2 LT1 LT0 │ RT0 RT1 RT2 RT3 RT4 RT5 │
  │ 12  13  14  15  16  17 │ 18  19  20  21  22  23 │ │ LM5 LM4 LM3 LM2 LM1 LM0 │ RM0 RM1 RM2 RM3 RM4 RM5 │
  │ 24  25  26  27  28  29 │ 30  31  32  33  34  35 │ │ LB5 LB4 LB3 LB2 LB1 LB0 │ RB0 RB1 RB2 RB3 RB4 RB5 │
  ╰───────────╮ 36  37  38 │ 39  40  41 ╭───────────╯ ╰───────────╮ LH2 LH1 LH0 │ RH0 RH1 RH2 ╭───────────╯
              ╰────────────┴────────────╯                         ╰─────────────┴─────────────╯             */


#define KEYS_L LT0 LT1 LT2 LT3 LT4 LT5 LM0 LM1 LM2 LM3 LM4 LM5 LB0 LB1 LB2 LB3 LB4 LB5
#define KEYS_R RT0 RT1 RT2 RT3 RT4 RT5 RM0 RM1 RM2 RM3 RM4 RM5 RB0 RB1 RB2 RB3 RB4 RB5
#define THUMBS LH2 LH1 LH0 RH0 RH1 RH2 // Thumbs on 36+ keys.


  #define ZMK_BASE_LAYER(name, LN, LT, LM, LB, LS, LLH, LH, RN,RT, RM, RS, RB, RH, RRH) \
      ZMK_LAYER(name, LT RT LM RM LB RB LH RH)

// #define L_LOW 1
// #define L_RAISE 2
// #define L_NAV 3


// / {
    // chosen { zmk,physical-layout = &foostan_corne_6col_layout; };
    // conditional_layers {
    //     compatible = "zmk,conditional-layers";

    //     tri_layer {
    //         if-layers = <1 2>;
    //         then-layer = <3>;
    //     };
    // };

// };

#include "base.keymap"

ZMK_COMBO(esc , &kp ESC , LT5 LT4, L_DEF)

