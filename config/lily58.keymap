/*
 * Copyright (c) 2020 The ZMK Contributors
 *
 * SPDX-License-Identifier: MIT
 */

#include "base.keymap"


//     keymap {
//         compatible = "zmk,keymap";

//         default_layer {
//             bindings = <
// &kp ESC       &kp N1      &kp N2      &kp N3        &kp N4       &kp N5                            &kp N6      &kp N7        &kp N8        &kp N9       &kp N0          &kp GRAVE
// &kp TAB       &kp Q       &kp W       &kp E         &kp R        &kp T                             &kp Y       &kp U         &kp I         &kp O        &kp P           &kp MINUS
// &kp LCTRL     &hml LGUI A &hml LALT S &hml LSHFT D  &hml LCTRL F &kp G                             &kp H       &hmr LCTRL J  &hmr LSHFT K  &hmr LALT L  &hmr LGUI SEMI  &kp SQT
// &caps LSHFT 0 &kp Z       &kp X       &kp C         &kp V        &kp B      &kp LBKT      &kp RBKT &kp N       &kp M         &kp COMMA     &kp DOT      &kp FSLH        &kp RSHFT
//                                       &kp LGUI      &kp DEL      &lt 1 BSPC &lt 3 SPACE   &kp RET  &lt 2 BSPC  &kp INS       &kp PSCRN
//             >;

//             sensor-bindings = <&inc_dec_kp C_VOL_UP C_VOL_DN>;
//         };

//         lower_layer {
//            bindings = <
// &bt BT_CLR  &bt BT_SEL 0 &bt BT_SEL 1 &bt BT_SEL 2 &bt BT_SEL 3 &bt BT_SEL 4               &trans    &trans    &trans    &trans    &trans    &trans
// &kp F1      &kp F2       &kp F3       &kp F4       &kp F5       &kp F6                     &kp F7    &kp F8    &kp F9    &kp F10   &kp F11   &kp F12
// &kp GRAVE   &kp EXCL     &kp AT       &kp HASH     &kp DOLLAR   &kp PRCNT                  &kp CARET &kp AMPS  &kp ASTRK &kp LPAR  &kp RPAR  &kp TILDE
// &trans      &trans       &trans       &trans       &trans       &kp LC(Z) &trans   &trans  &trans    &trans    &trans    &trans    &trans    &trans
//                                       &trans       &trans       &trans    &trans   &trans  &trans    &trans    &trans
//             >;

//             sensor-bindings = <&inc_dec_kp C_VOL_UP C_VOL_DN>;
//         };
//         raise_layer {
//             bindings = <
// &trans    &trans  &trans  &trans  &trans  &trans                   &trans  &trans  &trans  &trans   &trans  &trans
// &kp GRAVE &trans  &trans  &trans  &trans  &trans                   &kp F7  &kp F8  &kp F9  &kp F12  &trans  &trans
// &trans    &trans  &trans  &trans  &trans  &trans                   &kp F4  &kp F5  &kp F6  &kp F11  &trans  &trans
// &trans    &trans  &trans  &trans  &trans  &trans  &trans   &trans  &kp F1  &kp F2  &kp F3  &kp F10  &trans  &trans
//                           &trans  &trans  &trans  &trans   &trans  &trans  &trans  &trans
//             >;

//             sensor-bindings = <&inc_dec_kp C_VOL_UP C_VOL_DN>;
//         };
//         nav_layer {
//             bindings = <
// &bootloader  &trans    &trans    &trans    &trans     &trans                     &trans &trans &trans    &trans  &trans  &trans    
// &swap        &kp PG_UP &kp HOME  &kp UP    &kp END    &kp RET                    &kp N7  &kp N8  &kp N9  &trans  &trans  &trans
// &ctrl_h      &kp PG_DN &kp LEFT  &kp DOWN  &kp RIGHT  &kp BSPC                   &kp N4  &kp N5  &kp N6  &trans  &trans  &trans
// &shift_h     &trans    &kp BSPC  &trans    &trans     &kp DEL   &trans   &trans  &kp N1  &kp N2  &kp N3  &trans  &trans  &trans
//                                  &trans    &trans     &trans    &trans   &trans  &trans  &kp N0  &kp DOT
// >;
//         };
//     };

// &trans    &trans &trans &trans  &trans  &trans                         &trans      &trans    &trans    &trans   &trans    &trans
// &trans    &trans &trans &trans  &trans  &trans                         &trans      &trans    &trans    &trans   &trans    &trans
// &trans    &trans &trans &trans  &trans  &trans                         &trans      &trans    &trans    &trans   &trans    &trans
// &trans    &trans &trans &trans  &trans  &trans  &trans         &trans  &trans      &trans    &trans    &trans   &trans    &trans
//                         &trans  &trans  &trans  &trans         &trans  &trans      &trans    &trans 
