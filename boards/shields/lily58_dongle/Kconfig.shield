## boards/shields/lily58_dongle/Kconfig.shield
```kconfig
# No whitespace after the comma or in your keyboard name!
config SHIELD_LILY58_DONGLE
    def_bool $(shields_list_contains,lily58_dongle)
```

## boards/shields/macro_16/Kconfig.defconfig
```kconfig
if SHIELD_MACRO_16

# Name must be less than 16 characters long!
config ZMK_KEYBOARD_NAME
    default "Macro16"

endif
```

## boards/shields/macro_16/Kconfig.shield
```kconfig
# No whitespace after the comma or in your keyboard name!
config SHIELD_MACRO_16
    def_bool $(shields_list_contains,macro_16)
```

## config/west.yml
```yaml
manifest:
  remotes:
    - name: zmkfirmware
      url-base: https://github.com/zmkfirmware
    - name: theor
      url-base: https://github.com/theor
    - name: urob
      url-base: https://github.com/urob
    - name: englmaxi
      url-base: https://github.com/englmaxi
    - name: janpfischer
      url-base: https://github.com/janpfischer
    # Additional modules containing boards/shields/custom code can be listed here as well
    # See https://docs.zephyrproject.org/3.2.0/develop/west/manifest.html#projects
  projects:
    - name: zmk
      # remote: zmkfirmware
      remote: theor
      revision: main
      import: app/west.yml
    - name: zmk-display
      remote: theor
      revision: main
    - name: zmk-tri-state
      remote: urob
      revision: main
    # - name: zmk-dongle-display
    #   remote: englmaxi
    #   revision: v0.3 # use 'v0.3' instead of 'main' if you use have pinned zmk to 'v0.3' or below
      
    - name: zmk-dongle-screen
      remote: janpfischer
      revision: main
  self:
    path: config
    # self:
      # import: zmk-display
```

## lily-config/west.yml
```yaml
manifest:
  remotes:
    - name: zmkfirmware
      url-base: https://github.com/zmkfirmware
    - name: theor
      url-base: https://github.com/theor
    - name: urob
      url-base: https://github.com/urob
    # Additional modules containing boards/shields/custom code can be listed here as well
    # See https://docs.zephyrproject.org/3.2.0/develop/west/manifest.html#projects
  projects:
    - name: zmk
      remote: zmkfirmware
      revision: main
      import: app/west.yml
    - name: zmk-tri-state
      remote: urob
      revision: main
    # - name: zmk-display
    #   remote: theor
    #   # This points to a west manifest file in the remote module for further imports
    #   import: west.yml
  self:
    path: lily-config
    # self:
      # import: zmk-display
```
